&apc_vreg {
	qcom,cpr-speed-bin-corners =
		<9 0 9 0 0 0 7 9>;

	qcom,cpr-corners =
		/* Speed bin 0 */
		<9 9 9 9 9 9 9 9>,

		/* Speed bin 1 */
		<0 0 0 0 0 0 0 0>,

		/* Speed bin 2 */
		<9 9 9 9 9 9 9 9>,

		/* Speed bin 3..5 */
		<0 0 0 0 0 0 0 0>,
		<0 0 0 0 0 0 0 0>,
		<0 0 0 0 0 0 0 0>,

		/* Speed bin 6 */
		<7 7 7 7 7 7 7 7>,

		/* Speed bin 7 */
		<9 9 9 9 9 9 9 9>;

	qcom,cpr-corner-fmax-map =
		/* Speed bin 0 */
		<1 2 4 9>,

		/* Speed bin 1 */
		<0 0 0 0>,

		/* Speed bin 2 */
		<1 2 4 9>,

		/* Speed bin 3..5 */
		<0 0 0 0>,
		<0 0 0 0>,
		<0 0 0 0>,

		/* Speed bin 6 */
		<1 2 4 7>,

		/* Speed bin 7 */
		<1 2 4 9>;

	qcom,cpr-voltage-ceiling =
		/* Speed bin 0 */
		<605000  685000 735000 775000 815000
		855000 895000 950000 990000>,

		/* Speed bin 2 */
		<605000  685000 735000 775000 815000
		855000 895000 950000 990000>,

		/* Speed bin 6 */
		<605000  685000 735000 775000 815000
		855000 895000>,

		/* Speed bin 7 */
		<605000  685000 735000 775000 815000
		855000 895000 950000 990000>;

	qcom,cpr-voltage-floor =
		/* Speed bin 0 */
		<500000  500000 500000 500000 500000
		 500000  500000 500000 500000>,

		/* Speed bin 2 */
		<500000  500000 500000 500000 500000
		 500000  500000 500000 500000>,

		/* Speed bin 6 */
		<500000  500000 500000 500000 500000
		 500000  500000>,

		/* Speed bin 7 */
		<500000  500000 500000 500000 500000
		 500000  500000 500000 500000>;

	qcom,cpr-floor-to-ceiling-max-range =
		/* Speed bin 0; CPR rev 0..7 */
		<    0     0     0     0     0
		     0     0     0     0>,
		<50000 50000 50000 50000 50000
		 50000 50000 50000 50000>,
		<50000 50000 50000 50000 50000
		 50000 50000 50000 50000>,
		<50000 50000 50000 50000 50000
		 50000 50000 50000 50000>,
		<50000 50000 50000 50000 50000
		 50000 50000 50000 50000>,
		<50000 50000 50000 50000 50000
		 50000 50000 50000 50000>,
		<50000 50000 50000 50000 50000
		 50000 50000 50000 50000>,
		<50000 50000 50000 50000 50000
		 50000 50000 50000 50000>,

		/* Speed bin 2; CPR rev 0..7 */
		<    0     0     0     0     0
		     0     0     0     0>,
		<50000 50000 50000 50000 50000
		 50000 50000 50000 50000>,
		<50000 50000 50000 50000 50000
		 50000 50000 50000 50000>,
		<50000 50000 50000 50000 50000
		 50000 50000 50000 50000>,
		<50000 50000 50000 50000 50000
		 50000 50000 50000 50000>,
		<50000 50000 50000 50000 50000
		 50000 50000 50000 50000>,
		<50000 50000 50000 50000 50000
		 50000 50000 50000 50000>,
		<50000 50000 50000 50000 50000
		 50000 50000 50000 50000>,

		/* Speed bin 6; CPR rev 0..7 */
		<    0     0     0     0     0
		     0     0>,
		<50000 50000 50000 50000 50000
		 50000 50000>,
		<50000 50000 50000 50000 50000
		 50000 50000>,
		<50000 50000 50000 50000 50000
		 50000 50000>,
		<50000 50000 50000 50000 50000
		 50000 50000>,
		<50000 50000 50000 50000 50000
		 50000 50000>,
		<50000 50000 50000 50000 50000
		 50000 50000>,
		<50000 50000 50000 50000 50000
		 50000 50000>,

		/* Speed bin 7; CPR rev 0..7 */
		<    0     0     0     0     0
		     0     0     0     0>,
		<50000 50000 50000 50000 50000
		 50000 50000 50000 50000>,
		<50000 50000 50000 50000 50000
		 50000 50000 50000 50000>,
		<50000 50000 50000 50000 50000
		 50000 50000 50000 50000>,
		<50000 50000 50000 50000 50000
		 50000 50000 50000 50000>,
		<50000 50000 50000 50000 50000
		 50000 50000 50000 50000>,
		<50000 50000 50000 50000 50000
		 50000 50000 50000 50000>,
		<50000 50000 50000 50000 50000
		 50000 50000 50000 50000>;

	qcom,cpr-misc-fuse-voltage-adjustment =
		/* Speed bin 0; misc fuse 0..1 */
		<    0     0     0     0      0
		     0     0     0     0>,
		<    0     0 30000     0      0
		     0     0     0     0>,

		/* Speed bin 2; misc fuse 0..1 */
		<    0     0     0     0      0
		     0     0     0     0>,
		<    0     0 30000     0      0
		     0     0     0     0>,

		/* Speed bin 6; misc fuse 0..1 */
		<    0     0     0     0      0
		     0     0>,
		<    0     0 30000     0      0
		     0     0>,

		/* Speed bin 7; misc fuse 0..1 */
		<    0     0     0     0      0
		     0     0     0     0>,
		<    0     0 30000     0      0
		     0     0     0     0>;

	qcom,mem-acc-voltage =
		/* Speed bin 0 */
		<1 1 2 2 2 2 2 2 2>,

		/* Speed bin 2 */
		<1 1 2 2 2 2 2 2 2>,

		/* Speed bin 6 */
		<1 1 2 2 2 2 2>,

		/* Speed bin 7 */
		<1 1 2 2 2 2 2 2 2>;

	qcom,corner-frequencies =
		/* Speed bin 0 */
		<652800000 1036800000 1401600000
		1689600000 1804800000 1958400000
		2016000000 2150400000 2208000000>,

		/* Speed bin 2 */
		<652800000 1036800000 1401600000
		1689600000 1804800000 1958400000
		2016000000 2150400000 2208000000>,

		/* Speed bin 6 */
		<652800000 1036800000 1401600000
		1689600000 1804800000 1958400000
		2016000000>,

		/* Speed bin 7 */
		<652800000 1036800000 1401600000
		1689600000 1804800000 1958400000
		2016000000 2150400000 2208000000>;
};
